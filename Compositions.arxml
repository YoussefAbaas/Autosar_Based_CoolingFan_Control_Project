AUTOSAR XML (schema 00046)
package /Composition
  composition sw component type TemperatureControlComposition
    component EcuAbstComp: type=TempHBridgeSWC
    component AppSWComp: type=CoolingControlSWC
    connect EcuAbstComp.PP_Tempereture -> AppSWComp.RP_Temperature
    connect EcuAbstComp.PP_StartMotor -> AppSWComp.RP_StartMotor
    connect EcuAbstComp.PP_StopMotor -> AppSWComp.RP_StopMotor
