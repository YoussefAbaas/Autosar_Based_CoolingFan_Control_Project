AUTOSAR XML (schema 00046)
package /Interfaces
  sender receiver interface I_Tempreture
    data Tempreture: implementation-data-type=float32
  client server interface I_StartMotor
    operation StartMotor: possible-error=[E_OK, E_NOT_OK]
      arg Speed: type=uint8, direction=IN
    error E_OK: error-code=0x00
    error E_NOT_OK: error-code=0x01
  client server interface I_StopMotor
    operation StopMotor: possible-error=[E_OK, E_NOT_OK]
    error E_OK: error-code=0x00
    error E_NOT_OK: error-code=0x01
